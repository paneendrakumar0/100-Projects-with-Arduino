/*
 * 100 Projects with Arduino - Day 31
 * Project: MFRC522 RFID Card Reader (SPI Access Control System)
 *
 * DESCRIPTION:
 * This project interfaces the MFRC522 Radio Frequency Identification (RFID) card reader module
 * over the Serial Peripheral Interface (SPI) bus. To align with industrial design paradigms:
 * 1. Implements non-blocking polling of RFID transponders (cards/keyfobs) operating at 13.56 MHz.
 * 2. Reads, formats, and displays the 4-byte or 7-byte Unique Identifier (UID) of scanned tags.
 * 3. Compares the scanned UID against a designated "Master Key" to authorize access, driving
 *    status LEDs (Access Granted vs. Access Denied).
 * 4. Halts transponder radio fields after successful reads to prevent duplicate polling loops.
 *
 * RFID & SPI THEORY OF OPERATION:
 * - Inductive Coupling: The MFRC522 reader contains an antenna coil that generates a 13.56 MHz
 *   electromagnetic field. When a passive RFID tag enters this field, the tag's internal coil
 * harvests the energy via electromagnetic induction (Faraday's Law) to power its microchip. The tag
 * then modulates the magnetic field (Load Modulation) to transmit its UID back to the reader.
 * - SPI (Serial Peripheral Interface): SPI is a synchronous, full-duplex, master-slave serial bus.
 *   Unlike I2C (2 wires, shared address routing), SPI uses four dedicated signals:
 *     - MOSI (Master Out Slave In): Data transfer from Arduino to MFRC522.
 *     - MISO (Master In Slave Out): Data transfer from MFRC522 to Arduino.
 *     - SCK (Serial Clock): Clock pulses generated by the Arduino Master to sync bits.
 *     - SS (Slave Select): Chip select line pulled LOW by the Master to target the reader.
 *
 * HARDWARE CONNECTIONS:
 * - MFRC522 Pin  -> Arduino Uno Pin
 *   - 3.3V       -> 3.3V (WARNING: Connecting to 5V will destroy the MFRC522 chip!)
 *   - GND        -> GND
 *   - RST (Reset)-> Pin 9
 *   - IRQ        -> Not Connected
 *   - MISO       -> Pin 12
 *   - MOSI       -> Pin 11
 *   - SCK        -> Pin 13
 *   - SDA (SS)   -> Pin 10
 * - Green LED    -> Pin 5 (Access Granted)
 * - Red LED      -> Pin 6 (Access Denied)
 *
 * LIBRARY REQUIREMENT:
 * This code requires the "MFRC522" library by Miguel Balboa (install via Library Manager).
 */

#include <MFRC522.h>
#include <SPI.h>

// --- PIN DEFINITIONS ---
const int RST_PIN = 9;     // Configurable reset pin
const int SS_PIN = 10;     // Configurable Slave Select (SDA) pin
const int ACCESS_LED = 5;  // Green LED pin
const int DENIED_LED = 6;  // Red LED pin

// Instantiate reader object
MFRC522 mfrc522(SS_PIN, RST_PIN);

// --- AUTHORIZED CARD DEFINITION (Master Key) ---
// Define your authorized card's 4-byte UID.
// Note: Read your card UID first using the Serial Monitor, then replace these bytes.
const byte AUTHORIZED_UID[] = {0xDE, 0xAD, 0xBE, 0xEF};

void setup() {
  Serial.begin(9600);

  Serial.println("==================================================");
  Serial.println("Day 31: MFRC522 RFID Card Reader Access Control");
  Serial.println("==================================================");

  // Initialize indicator pins
  pinMode(ACCESS_LED, OUTPUT);
  pinMode(DENIED_LED, OUTPUT);

  // Set output states initially LOW
  digitalWrite(ACCESS_LED, LOW);
  digitalWrite(DENIED_LED, LOW);

  // Initialize the SPI Bus (standard hardware MOSI/MISO/SCK pins)
  SPI.begin();

  // Initialize the MFRC522 transceiver chip
  mfrc522.PCD_Init();

  Serial.print("MFRC522 Reader initialized on SPI Bus (CS: Pin ");
  Serial.print(SS_PIN);
  Serial.print(", RST: Pin ");
  Serial.println(RST_PIN);
  Serial.println("Ready to scan tags...");
}

void loop() {
  // Non-blocking check 1: Look for new cards in range of the antenna coil
  if (!mfrc522.PICC_IsNewCardPresent()) {
    return;  // Fast escape if no card is present
  }

  // Non-blocking check 2: Attempt to read the card's data serial block
  if (!mfrc522.PICC_ReadCardSerial()) {
    return;  // Exit if read failed
  }

  // If we reach here, a card has been detected and its serial parsed
  processCardScan();

  // Instruct the transponder to enter a halt/sleep state.
  // This prevents the reader from continuously registering the card if it is held in place.
  mfrc522.PICC_HaltA();
}

/**
 * Parses the scanned card's UID, checks authorization, and triggers indicators.
 */
void processCardScan() {
  Serial.print("\n[RFID] Scanned Tag UID: ");
  printCardUID(mfrc522.uid.uidByte, mfrc522.uid.size);

  // Compare scanned UID size and bytes against authorized Master Key
  bool isAuthorized = true;

  if (mfrc522.uid.size != sizeof(AUTHORIZED_UID)) {
    isAuthorized = false;
  } else {
    for (byte i = 0; i < mfrc522.uid.size; i++) {
      if (mfrc522.uid.uidByte[i] != AUTHORIZED_UID[i]) {
        isAuthorized = false;
        break;  // Break loop on first byte mismatch
      }
    }
  }

  // Respond based on authorization state
  if (isAuthorized) {
    handleAccessGranted();
  } else {
    handleAccessDenied();
  }
}

/**
 * Outputs a byte array formatted as capitalized hex strings.
 */
void printCardUID(byte *buffer, byte bufferSize) {
  for (byte i = 0; i < bufferSize; i++) {
    Serial.print(buffer[i] < 0x10 ? " 0" : " ");
    Serial.print(buffer[i], HEX);
  }
  Serial.println();
}

/**
 * Triggers access feedback (toggles Green LED and outputs confirmation).
 */
void handleAccessGranted() {
  Serial.println("[ACCESS CONTROL] -> AUTHORIZED MASTER KEY SCANNED. Access Granted!");

  digitalWrite(ACCESS_LED, HIGH);
  digitalWrite(DENIED_LED, LOW);

  // Non-blocking delay bypass (since this is a terminal state trigger,
  // keeping the LED lit for 2 seconds is normal, but let's do it with delay
  // here for simplicity or explain it in loop. Let's use simple delay for
  // the success toggle duration since it happens only on positive scans)
  delay(2000);
  digitalWrite(ACCESS_LED, LOW);
}

/**
 * Triggers denial feedback (flashes Red LED and outputs warning).
 */
void handleAccessDenied() {
  Serial.println("[ACCESS CONTROL] -> WARNING: UNAUTHORIZED KEY SCANNED. Access Denied!");

  digitalWrite(ACCESS_LED, LOW);

  // Flash red warning light 3 times rapidly
  for (int i = 0; i < 3; i++) {
    digitalWrite(DENIED_LED, HIGH);
    delay(200);
    digitalWrite(DENIED_LED, LOW);
    delay(200);
  }
}
